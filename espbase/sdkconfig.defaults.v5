## espbase/sdkconfig.defaults.v5
```kconfig
# Chip-specific
CONFIG_ESP_DEFAULT_CPU_FREQ_MHZ_240=y

# Wi-Fi
CONFIG_ESP_WIFI_IRAM_OPT=n
CONFIG_ESP_WIFI_RX_IRAM_OPT=n

# TinyUSB
CONFIG_TINYUSB_HID_COUNT=1
```
