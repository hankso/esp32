## espbase/sdkconfig.defaults
```kconfig
# Serial flasher config
CONFIG_ESPTOOLPY_FLASHSIZE_4MB=y

# Partition Table
CONFIG_PARTITION_TABLE_CUSTOM=y
CONFIG_PARTITION_TABLE_CUSTOM_FILENAME="partitions.csv"
CONFIG_PARTITION_TABLE_FILENAME="partitions.csv"

# HTTP Server
CONFIG_HTTPD_MAX_REQ_HDR_LEN=1024

# ESP System Settings
CONFIG_ESP_SYSTEM_PANIC_PRINT_HALT=y
CONFIG_ESP_SYSTEM_EVENT_TASK_STACK_SIZE=4096
CONFIG_ESP_MAIN_TASK_STACK_SIZE=8192
CONFIG_ESP_MAIN_TASK_AFFINITY_NO_AFFINITY=y
CONFIG_ESP_TASK_WDT_CHECK_IDLE_TASK_CPU0=n
CONFIG_ESP_TASK_WDT_CHECK_IDLE_TASK_CPU1=n

# FreeRTOS
CONFIG_FREERTOS_HZ=1000
CONFIG_FREERTOS_USE_TRACE_FACILITY=y
CONFIG_FREERTOS_USE_STATS_FORMATTING_FUNCTIONS=y
CONFIG_FREERTOS_VTASKLIST_INCLUDE_COREID=y
CONFIG_FREERTOS_GENERATE_RUN_TIME_STATS=y
CONFIG_FREERTOS_RUN_TIME_STATS_USING_ESP_TIMER=y

# Log output
CONFIG_LOG_TIMESTAMP_SOURCE_SYSTEM=y

# LWIP
CONFIG_LWIP_LOCAL_HOSTNAME="espbase"
CONFIG_LWIP_MAX_SOCKETS=16

# FAT Filesystem support
CONFIG_FATFS_LFN_HEAP=y

# SPIFFS Configuration
CONFIG_SPIFFS_OBJ_NAME_LEN=64

# LVGL configuration
CONFIG_LV_MEM_CUSTOM=y
CONFIG_LV_MEMCPY_MEMSET_STD=y
CONFIG_LV_FONT_MONTSERRAT_14=n
CONFIG_LV_FONT_DEFAULT_UNSCII_8=y
CONFIG_LV_USE_PNG=y
CONFIG_LV_USE_PERF_MONITOR=y
CONFIG_LV_USE_USER_DATA=y
CONFIG_LV_USE_FS_POSIX=y
CONFIG_LV_FS_POSIX_LETTER=83
CONFIG_LV_FS_POSIX_CACHE_SIZE=65535
```

## espbase/sdkconfig.defaults.esp32s3
```kconfig
# SPI RAM config
CONFIG_SPIRAM_MODE_OCT=y

# Console Library
CONFIG_ESP_CONSOLE_USB_SERIAL_JTAG=y
```

## testing/probe/main/Kconfig.projbuild
```kconfig
menu "Extra Configuration"

config LED_GPIO
    int "LED GPIO number"
	range 0 34
	default 2
	help
		GPIO number (IOxx) to blink on and off.

		Some GPIOs are used for other purposes (flash connections, etc.) and cannot be used to blink.

		GPIOs 35-39 are input-only so cannot be used as outputs.

config PROBE_GPIO
    int "PROBE GPIO number"
    range 0 39
    default 23
    help
        GPIO number (IOxx) to probe HIGH or LOW(by digitalRead).


endmenu
```

## testing/sleep/main/Kconfig.projbuild
```kconfig
menu "Extra Configuration"

config WAKEUP_GPIO
    int "Wakeup GPIO number"
	range 0 34
	default 0
	help
		GPIO number (IOxx) to blink on and off.

		Some GPIOs are used for other purposes (flash connections, etc.) and cannot be used to blink.

		GPIOs 35-39 are input-only so cannot be used as outputs.

endmenu
```
